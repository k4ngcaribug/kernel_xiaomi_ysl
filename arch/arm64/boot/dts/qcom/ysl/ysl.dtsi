#include "soc.dtsi"
#include "pinctrl.dtsi"
#include "ysl-pinctrl.dtsi"
#include "android.dtsi"
#include "cpu.dtsi"
#include "gpu.dtsi"
#include "audio.dtsi"
#include "battery.dtsi"
#include "misc.dtsi"
#include "pstore.dtsi"
#include "display.dtsi"
#include "fingerprint.dtsi"
#include "power.dtsi"
#include "touchscreen.dtsi"
#include "camera.dtsi"
#include "regulator.dtsi"
