/* msm8953-mdss-panels */
#include "panel/dsi-panel-truly-hd720-video.dtsi"
#include "panel/dsi-panel-auo-hd720-video.dtsi"
#include "panel/dsi-panel-shenchao-ili9881c-hd720-video.dtsi"

&dsi_truly_hd720_vid {
	qcom,mdss-dsi-panel-timings-phy-v2 = [1e 1c 04 06 02 03 04 a0
		1e 1c 04 06 02 03 04 a0
		1e 1c 04 06 02 03 04 a0
		1e 1c 04 06 02 03 04 a0
		1e 0f 04 05 02 03 04 a0];
};

&dsi_auo_hd720_vid {
	qcom,mdss-dsi-panel-timings-phy-v2 = [20 1c 06 07 03 03 04 a0
         20 1c 06 07 03 03 04 a0
         20 1c 06 07 03 03 04 a0
         20 1c 06 07 03 03 04 a0
         20 13 05 06 03 03 04 a0];
};

&dsi_sc_ili9881c_hd720_video {
        qcom,mdss-dsi-panel-timings-phy-v2 = [1f 1c 05 07 03 03 04 a0
         1f 1c 05 07 03 03 04 a0
         1f 1c 05 07 03 03 04 a0
         1f 1c 05 07 03 03 04 a0
         1f 11 05 06 03 03 04 a0];
};