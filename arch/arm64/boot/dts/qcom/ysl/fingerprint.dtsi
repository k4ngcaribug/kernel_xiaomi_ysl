&soc {
	fpc1020 {
		status = "ok";
		compatible = "fpc,fpc1020";
		interrupt-parent = <&tlmm>;
		interrupts = <48 0x0>;
		fpc,gpio_rst = <&tlmm 140 0x0>;
		fpc,gpio_irq = <&tlmm 48 0x0>;
		fpc,gpio_ldo_en = <&tlmm 47 0x0>;

		vcc_spi-supply = <&pm8953_l6>;
		vdd_io-supply = <&pm8953_l6>;
		vdd_ana-supply = <&pm8953_l6>;

		pinctrl-names = "fpc1020_reset_reset",
			"fpc1020_reset_active",
			"fpc1020_irq_active",
            "fpc1020_ldo_2v8_en";
		pinctrl-0 = <&fp_reset_low>;
		pinctrl-1 = <&fp_reset_high>;
		pinctrl-2 = <&fp_irq_active>;
		pinctrl-3 = <&fp_ldo_2v8_en>;
	};

    goodix_fp {
		status = "ok";
		compatible = "goodix,fingerprint";
		interrupt-parent = <&tlmm>;
		interrupts = <48 0x0>;
		goodix,gpio_reset = <&tlmm 140 0x0>;
		goodix,gpio_irq = <&tlmm 48 0x0>;
		goodix,gpio_pwr = <&tlmm 47 0x0>;

		vcc_spi-supply = <&pm8953_l6>;
		vdd_io-supply = <&pm8953_l6>;
		vdd_ana-supply = <&pm8953_l6>;
	};
};